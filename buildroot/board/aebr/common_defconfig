## buildroot/board/aebr/common_defconfig
```kconfig
# Common Aesthetic Buildroot configs

# System configuration
BR2_TARGET_ROOTFS_EXT2_SIZE="1G"
BR2_TARGET_GENERIC_HOSTNAME="aesthetic"
BR2_TARGET_GENERIC_ROOT_PASSWD="aesthetic"
BR2_INIT_SYSTEMD=y

# Keep root filesystem read-only
# BR2_TARGET_GENERIC_REMOUNT_ROOTFS_RW is not set

# Overlay
BR2_ROOTFS_OVERLAY="board/aebr/rootfs-overlay"

# Linux kernel extras
BR2_LINUX_KERNEL_CONFIG_FRAGMENT_FILES="board/aebr/linux.fragment"

# BTRFS
BR2_PACKAGE_BTRFS_PROGS=y

# Time synchronization
BR2_PACKAGE_CHRONY=y

# SSH
BR2_PACKAGE_DROPBEAR=y

# Hardware RNG
BR2_PACKAGE_RNG_TOOLS=y

# ALSA
BR2_PACKAGE_ALSA_LIB=y
BR2_PACKAGE_ALSA_UTILS=y
BR2_PACKAGE_ALSA_UTILS_ALSACTL=y
BR2_PACKAGE_ALSA_UTILS_ALSAMIXER=y
BR2_PACKAGE_ALSA_UTILS_AMIXER=y
BR2_PACKAGE_ALSA_UTILS_APLAY=y
BR2_PACKAGE_ALSA_UTILS_SPEAKER_TEST=y
BR2_PACKAGE_ALSA_UTILS_IECSET=y

# Avahi
BR2_PACKAGE_AVAHI=y
BR2_PACKAGE_AVAHI_DAEMON=y
BR2_PACKAGE_AVAHI_AUTOIPD=y

# WiFi support
BR2_PACKAGE_IWD=y

# Wireless networking tools
BR2_PACKAGE_IW=y

# General networking tools
BR2_PACKAGE_ETHTOOL=y
BR2_PACKAGE_IPERF3=y
BR2_PACKAGE_TCPDUMP=y
BR2_PACKAGE_BRIDGE_UTILS=y
```

## buildroot/board/aebr/qemu/defconfig
```kconfig
# Aesthetic qemu specific defconfigs

# Linux kernel extras
BR2_LINUX_KERNEL_CONFIG_FRAGMENT_FILES="board/aebr/qemu/linux.fragment"
```

## buildroot/board/aebr/rpi3/defconfig
```kconfig
# Aesthetic rpi3 specific defconfigs

# Linux kernel extras
BR2_LINUX_KERNEL_CONFIG_FRAGMENT_FILES="board/aebr/rpi3/linux.fragment"

# Custom boot params
BR2_PACKAGE_RPI_FIRMWARE_CONFIG_FILE="board/aebr/rpi3/config.txt"
BR2_PACKAGE_RPI_FIRMWARE_CMDLINE_FILE="board/aebr/rpi3/cmdline.txt"

# WiFi firmware - RPi-specific packages
BR2_PACKAGE_LINUX_FIRMWARE=y
BR2_PACKAGE_BRCMFMAC_SDIO_FIRMWARE_RPI=y
BR2_PACKAGE_BRCMFMAC_SDIO_FIRMWARE_RPI_WIFI=y
```

## buildroot/configs/aebr_qemu_defconfig
```kconfig
BR2_aarch64=y
BR2_PACKAGE_HOST_LINUX_HEADERS_CUSTOM_6_12=y
BR2_GLOBAL_PATCH_DIR="board/qemu/patches"
BR2_DOWNLOAD_FORCE_CHECK_HASHES=y
BR2_SYSTEM_DHCP="eth0"
BR2_ROOTFS_POST_IMAGE_SCRIPT="board/qemu/post-image.sh"
BR2_ROOTFS_POST_SCRIPT_ARGS="$(BR2_DEFCONFIG)"
BR2_LINUX_KERNEL=y
BR2_LINUX_KERNEL_CUSTOM_VERSION=y
BR2_LINUX_KERNEL_CUSTOM_VERSION_VALUE="6.12.27"
BR2_LINUX_KERNEL_USE_CUSTOM_CONFIG=y
BR2_LINUX_KERNEL_CUSTOM_CONFIG_FILE="board/qemu/aarch64-virt/linux.config"
BR2_LINUX_KERNEL_NEEDS_HOST_OPENSSL=y
BR2_TARGET_ROOTFS_EXT2=y
BR2_TARGET_ROOTFS_EXT2_4=y
# BR2_TARGET_ROOTFS_TAR is not set
BR2_PACKAGE_HOST_QEMU=y
BR2_PACKAGE_HOST_QEMU_SYSTEM_MODE=y
# Aesthetic qemu specific defconfigs

# Linux kernel extras
BR2_LINUX_KERNEL_CONFIG_FRAGMENT_FILES="board/aebr/qemu/linux.fragment"
# Common Aesthetic Buildroot configs

# System configuration
BR2_TARGET_ROOTFS_EXT2_SIZE="1G"
BR2_TARGET_GENERIC_HOSTNAME="aesthetic"
BR2_TARGET_GENERIC_ROOT_PASSWD="aesthetic"
BR2_INIT_SYSTEMD=y

# Keep root filesystem read-only
# BR2_TARGET_GENERIC_REMOUNT_ROOTFS_RW is not set

# Overlay
BR2_ROOTFS_OVERLAY="board/aebr/rootfs-overlay"

# BTRFS
BR2_PACKAGE_BTRFS_PROGS=y

# Time synchronization
BR2_PACKAGE_CHRONY=y

# SSH
BR2_PACKAGE_DROPBEAR=y

# Hardware RNG
BR2_PACKAGE_RNG_TOOLS=y

# ALSA
BR2_PACKAGE_ALSA_LIB=y
BR2_PACKAGE_ALSA_UTILS=y
BR2_PACKAGE_ALSA_UTILS_ALSACTL=y
BR2_PACKAGE_ALSA_UTILS_ALSAMIXER=y
BR2_PACKAGE_ALSA_UTILS_AMIXER=y
BR2_PACKAGE_ALSA_UTILS_APLAY=y
BR2_PACKAGE_ALSA_UTILS_SPEAKER_TEST=y
BR2_PACKAGE_ALSA_UTILS_IECSET=y

# Avahi
BR2_PACKAGE_AVAHI=y
BR2_PACKAGE_AVAHI_DAEMON=y
BR2_PACKAGE_AVAHI_AUTOIPD=y

# WiFi support
BR2_PACKAGE_IWD=y

# Wireless networking tools
BR2_PACKAGE_IW=y

# General networking tools
BR2_PACKAGE_ETHTOOL=y
BR2_PACKAGE_IPERF3=y
BR2_PACKAGE_TCPDUMP=y
BR2_PACKAGE_BRIDGE_UTILS=y
```

## configs/rpi3/defconfig
```kconfig
# Aesthetic rpi3 specific defconfigs

# Custom boot params
BR2_PACKAGE_RPI_FIRMWARE_CONFIG_FILE="board/aebr/rpi3/config.txt"
BR2_PACKAGE_RPI_FIRMWARE_CMDLINE_FILE="board/aebr/rpi3/cmdline.txt"

# WiFi firmware - RPi-specific packages
BR2_PACKAGE_LINUX_FIRMWARE=y
BR2_PACKAGE_BRCMFMAC_SDIO_FIRMWARE_RPI=y
BR2_PACKAGE_BRCMFMAC_SDIO_FIRMWARE_RPI_WIFI=y
```

## cowsay-external/configs/cowsay_rpi3_defconfig
```kconfig
BR2_arm=y
BR2_cortex_a53=y
BR2_ARM_FPU_NEON_VFPV4=y
BR2_PACKAGE_HOST_LINUX_HEADERS_CUSTOM_6_6=y
BR2_TOOLCHAIN_BUILDROOT_CXX=y
BR2_GLOBAL_PATCH_DIR="board/raspberrypi/patches"
BR2_DOWNLOAD_FORCE_CHECK_HASHES=y
BR2_SYSTEM_DHCP="eth0"
BR2_ROOTFS_POST_BUILD_SCRIPT="board/raspberrypi3/post-build.sh"
BR2_ROOTFS_POST_IMAGE_SCRIPT="board/raspberrypi3/post-image.sh"
BR2_LINUX_KERNEL=y
BR2_LINUX_KERNEL_CUSTOM_TARBALL=y
BR2_LINUX_KERNEL_CUSTOM_TARBALL_LOCATION="$(call github,raspberrypi,linux,576cc10e1ed50a9eacffc7a05c796051d7343ea4)/linux-576cc10e1ed50a9eacffc7a05c796051d7343ea4.tar.gz"
BR2_LINUX_KERNEL_DEFCONFIG="bcm2709"
BR2_LINUX_KERNEL_DTS_SUPPORT=y
BR2_LINUX_KERNEL_INTREE_DTS_NAME="broadcom/bcm2710-rpi-3-b broadcom/bcm2710-rpi-3-b-plus broadcom/bcm2710-rpi-cm3"
BR2_LINUX_KERNEL_NEEDS_HOST_OPENSSL=y
BR2_PACKAGE_BUSYBOX_SHOW_OTHERS=y
BR2_PACKAGE_XZ=y
BR2_PACKAGE_RPI_FIRMWARE=y
BR2_PACKAGE_RPI_FIRMWARE_BOOTCODE_BIN=y
BR2_PACKAGE_RPI_FIRMWARE_VARIANT_PI=y
BR2_PACKAGE_RPI_FIRMWARE_CONFIG_FILE="board/raspberrypi3/config_3.txt"
BR2_PACKAGE_KMOD=y
BR2_PACKAGE_KMOD_TOOLS=y
BR2_TARGET_ROOTFS_EXT2=y
BR2_TARGET_ROOTFS_EXT2_4=y
BR2_TARGET_ROOTFS_EXT2_SIZE="120M"
# BR2_TARGET_ROOTFS_TAR is not set
BR2_PACKAGE_HOST_DOSFSTOOLS=y
BR2_PACKAGE_HOST_GENIMAGE=y
BR2_PACKAGE_HOST_KMOD_XZ=y
BR2_PACKAGE_HOST_MTOOLS=y

# Aesthetic rpi3 specific defconfigs
# Custom boot params
BR2_PACKAGE_RPI_FIRMWARE_CONFIG_FILE="board/aebr/rpi3/config.txt"
BR2_PACKAGE_RPI_FIRMWARE_CMDLINE_FILE="board/aebr/rpi3/cmdline.txt"

# WiFi firmware - RPi-specific packages
BR2_PACKAGE_LINUX_FIRMWARE=y
BR2_PACKAGE_BRCMFMAC_SDIO_FIRMWARE_RPI=y
BR2_PACKAGE_BRCMFMAC_SDIO_FIRMWARE_RPI_WIFI=y

# Common Aesthetic Buildroot configs
# System configuration
BR2_TARGET_ROOTFS_EXT2_SIZE="1G"
BR2_TARGET_GENERIC_HOSTNAME="aesthetic"
BR2_TARGET_GENERIC_ROOT_PASSWD="aesthetic"
BR2_INIT_SYSTEMD=y

# Keep root filesystem read-only
# BR2_TARGET_GENERIC_REMOUNT_ROOTFS_RW is not set

# Overlay
BR2_ROOTFS_OVERLAY="board/aebr/rootfs-overlay"

# Linux kernel extras
BR2_LINUX_KERNEL_CONFIG_FRAGMENT_FILES="board/aebr/linux.fragment"

# BTRFS
BR2_PACKAGE_BTRFS_PROGS=y

# Time synchronization
BR2_PACKAGE_CHRONY=y

# SSH
BR2_PACKAGE_DROPBEAR=y

# Hardware RNG
BR2_PACKAGE_RNG_TOOLS=y

# ALSA
BR2_PACKAGE_ALSA_LIB=y
BR2_PACKAGE_ALSA_UTILS=y
BR2_PACKAGE_ALSA_UTILS_ALSACTL=y
BR2_PACKAGE_ALSA_UTILS_ALSAMIXER=y
BR2_PACKAGE_ALSA_UTILS_AMIXER=y
BR2_PACKAGE_ALSA_UTILS_APLAY=y
BR2_PACKAGE_ALSA_UTILS_SPEAKER_TEST=y
BR2_PACKAGE_ALSA_UTILS_IECSET=y

# Avahi
BR2_PACKAGE_AVAHI=y
BR2_PACKAGE_AVAHI_DAEMON=y
BR2_PACKAGE_AVAHI_AUTOIPD=y

# WiFi support
BR2_PACKAGE_IWD=y

# Wireless networking tools
BR2_PACKAGE_IW=y

# General networking tools
BR2_PACKAGE_ETHTOOL=y
BR2_PACKAGE_IPERF3=y
BR2_PACKAGE_TCPDUMP=y
BR2_PACKAGE_BRIDGE_UTILS=y

# Cowsay package
BR2_PACKAGE_RUST_COWSAY=y
```

## cowsay-external/package/rust-cowsay/Config.in
```kconfig
config BR2_PACKAGE_RUST_COWSAY
	bool "rust-cowsay"
	depends on BR2_PACKAGE_HOST_RUSTC_TARGET_ARCH_SUPPORTS
	select BR2_PACKAGE_HOST_RUSTC
	help
	  A Rust implementation of the classic cowsay program.

	  https://github.com/wesc/rust-cowsay
```

## miles-external/Config.in
```kconfig
source "$BR2_EXTERNAL_MILES_PATH/package/rust-bindgen70/Config.in.host"
source "$BR2_EXTERNAL_MILES_PATH/package/librespot/Config.in"
source "$BR2_EXTERNAL_MILES_PATH/package/miles-init/Config.in"
```

## miles-external/package/librespot/Config.in
```kconfig
config BR2_PACKAGE_LIBRESPOT
  bool "librespot"
  depends on BR2_PACKAGE_HOST_RUSTC_TARGET_ARCH_SUPPORTS
  select BR2_PACKAGE_HOST_RUSTC
  select BR2_PACKAGE_HOST_RUST_BINDGEN70
  select BR2_PACKAGE_HOST_CMAKE
  select BR2_PACKAGE_CA_CERTIFICATES
  select BR2_PACKAGE_OPENSSL
  help
    Open Source Spotify client library

comment "Compilation options"
  depends on BR2_PACKAGE_LIBRESPOT

config BR2_PACKAGE_LIBRESPOT_VERSION
  depends on BR2_PACKAGE_LIBRESPOT
  string "version"
  default "miles-0.1"
  help
    Use either a branch name or commit from github.com/librespot-org/librespot.

config BR2_PACKAGE_LIBRESPOT_BUILD_OPTS
  depends on BR2_PACKAGE_LIBRESPOT
  string "build options"
  default "--no-default-features --features native-tls,rodio-backend,with-libmdns"

comment "Configuration variables"
  depends on BR2_PACKAGE_LIBRESPOT

config BR2_PACKAGE_LIBRESPOT_CONF_NAME
  depends on BR2_PACKAGE_LIBRESPOT
  string "Display name"
  default "Miles Audio Player"
  help
    The name shown in the interface.

config BR2_PACKAGE_LIBRESPOT_CONF_DEVICE_TYPE
  depends on BR2_PACKAGE_LIBRESPOT
  string "Device type"
  default "avr"
  help
    The device type influences the icon displayed in the interface. Can be:
    computer, tablet, tv, avr, stb, audiodongle, gameconsole, castaudio, castvideo,
    automobile, smartwatch, chromebook, carthing, homething

config BR2_PACKAGE_LIBRESPOT_CONF_SYSTEM_CACHE
  depends on BR2_PACKAGE_LIBRESPOT
  string "System cache directory"
  default "/tmp/librespot"
  help
    Path to a directory with system files, e.g. credentials.json and volume config.

config BR2_PACKAGE_LIBRESPOT_CONF_CACHE
  depends on BR2_PACKAGE_LIBRESPOT
  string "Cache directory"
  default "/var/cache/librespot"
  help
    Path to a directory where librespot stores cached audio files.

config BR2_PACKAGE_LIBRESPOT_CONF_CACHE_SIZE_LIMIT
  depends on BR2_PACKAGE_LIBRESPOT
  string "Cache size limit"
  default "128M"
  help
    Limit the size of the cache directory. Use suffixes like K, M, G for
    kilobytes, megabytes, gigabytes respectively.

config BR2_PACKAGE_LIBRESPOT_CONF_VOLUME_CTRL
  depends on BR2_PACKAGE_LIBRESPOT
  string "Volume control"
  default "log"
  help
    The type of volume control to use from fixed, linear, log or cubic.

config BR2_PACKAGE_LIBRESPOT_CONF_BITRATE
  depends on BR2_PACKAGE_LIBRESPOT
  string "Audio Bitrate"
  default "320"
  help
    Choose the bitrate in kbps from 96, 160 or 320.
```

## miles-external/package/miles-init/Config.in
```kconfig
config BR2_PACKAGE_MILES_INIT
	bool "miles-init"
	help
	  Miles Audio initialization package that sets up audio configuration,
	  volume controls, and enables required services at boot time.
```

## miles-external/package/rust-bindgen70/Config.in.host
```kconfig
config BR2_PACKAGE_HOST_RUST_BINDGEN70
	bool "host rust-bindgen70"
	depends on BR2_PACKAGE_HOST_RUSTC
	select BR2_PACKAGE_CLANG
	help
	  Rust bindgen tool for generating bindings to C libraries.
	  
	  This version is based on bindgen 0.70.1.
	  
	  https://github.com/rust-lang/rust-bindgen
```
